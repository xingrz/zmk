## app/boards/arm/kb16/Kconfig.board
```kconfig
# KB16-01 board configuration

# Copyright (c) 2022 The ZMK Contributors
# SPDX-License-Identifier: MIT

config BOARD_KB16
	bool "KB16-01"
	depends on SOC_STM32F103XB
```

## app/boards/arm/kb16/Kconfig.defconfig
```kconfig
# KB16-01 board configuration

# Copyright (c) 2022 The ZMK Contributors
# SPDX-License-Identifier: MIT

if BOARD_KB16

config BOARD
	default "kb16"

config ZMK_KEYBOARD_NAME
	default "KB16-01"

config ZMK_USB
	default y

config ZMK_RGB_UNDERGLOW
	select PWM
	select WS2812_STRIP_PWM

config ZMK_DISPLAY
	select I2C
	select SSD1306
	select SSD1306_REVERSE_MODE

endif # BOARD_KB16
```

## app/boards/arm/kb16/kb16_defconfig
```kconfig
# Copyright (c) 2022 The ZMK Contributors
# SPDX-License-Identifier: MIT

# SoC
CONFIG_SOC_SERIES_STM32F1X=y
CONFIG_SOC_STM32F103XB=y
CONFIG_CLOCK_CONTROL=y
CONFIG_PINCTRL=y

# Logging
# CONFIG_ZMK_USB_LOGGING=y
CONFIG_LOG_BUFFER_SIZE=1024

# Key scanning
CONFIG_GPIO_STM32_SWJ_NOJTAG=y
CONFIG_ZMK_KSCAN_MATRIX_POLLING=y
CONFIG_ZMK_HID_REPORT_TYPE_NKRO=y

# Encoder
CONFIG_EC11=y
CONFIG_EC11_TRIGGER_GLOBAL_THREAD=y

# RGB
CONFIG_ZMK_RGB_UNDERGLOW=y
CONFIG_ZMK_RGB_UNDERGLOW_EXT_POWER=n
CONFIG_ZMK_RGB_UNDERGLOW_AUTO_OFF_USB=y

# Storage
CONFIG_FLASH=y
CONFIG_FLASH_PAGE_LAYOUT=y
CONFIG_FLASH_MAP=y
CONFIG_NVS=y
CONFIG_SETTINGS=y
CONFIG_SETTINGS_NVS=y

# System
CONFIG_USB_DEVICE_VID=0xFEED
CONFIG_USB_DEVICE_PID=0x6060
CONFIG_USE_DT_CODE_PARTITION=y
```

## app/boards/arm/nz75/Kconfig.board
```kconfig
# NZ75 board configuration

# Copyright (c) 2022 The ZMK Contributors
# SPDX-License-Identifier: MIT

config BOARD_NZ75
	bool "NZ75"
	depends on SOC_NRF52840_QIAA
```

## app/boards/arm/nz75/Kconfig.defconfig
```kconfig
# NZ75 board configuration

# Copyright (c) 2022 The ZMK Contributors
# SPDX-License-Identifier: MIT

if BOARD_NZ75

config BOARD
	default "nz75"

config ZMK_KEYBOARD_NAME
	default "NZ75"

if USB_DEVICE_STACK

config USB_NRFX
	default y

endif # USB_DEVICE_STACK

config BT_CTLR
	default BT

config ZMK_BLE
	default y

config ZMK_USB
	default y

endif # BOARD_NZ75
```

## app/boards/arm/nz75/nz75_defconfig
```kconfig
# Copyright (c) 2022 The ZMK Contributors
# SPDX-License-Identifier: MIT

# SoC
CONFIG_SOC_SERIES_NRF52X=y
CONFIG_SOC_NRF52840_QIAA=y
CONFIG_ARM_MPU=y
CONFIG_HW_STACK_PROTECTION=y
CONFIG_MPU_ALLOW_FLASH_WRITE=y

# Buses
CONFIG_GPIO=y
CONFIG_SPI=y
CONFIG_SERIAL=y

# System
CONFIG_USE_DT_CODE_PARTITION=y

# Logging
CONFIG_LOG=y
CONFIG_CONSOLE=y
CONFIG_UART_CONSOLE=y

# RGB
CONFIG_LED_STRIP=y
CONFIG_WS2812_STRIP=y
CONFIG_WS2812_STRIP_SPI=y
CONFIG_ZMK_RGB_UNDERGLOW=y
CONFIG_ZMK_RGB_UNDERGLOW_EXT_POWER=n
CONFIG_ZMK_RGB_UNDERGLOW_AUTO_OFF_USB=y

# Storage
CONFIG_FLASH=y
CONFIG_FLASH_PAGE_LAYOUT=y
CONFIG_FLASH_MAP=y
CONFIG_NVS=y
CONFIG_SETTINGS=y
CONFIG_SETTINGS_NVS=y
```

## app/boards/arm/stm32/Kconfig.board
```kconfig
# Copyright (c) 2022 The ZMK Contributors
# SPDX-License-Identifier: MIT

config BOARD_STM32_F1
	bool "STM32 F1"
	depends on SOC_STM32F103XB

config BOARD_STM32_L4
	bool "STM32 L4"
	depends on SOC_STM32L432XX
```

## app/boards/arm/stm32/Kconfig.defconfig
```kconfig
# Copyright (c) 2022 The ZMK Contributors
# SPDX-License-Identifier: MIT

if BOARD_STM32_F1 || BOARD_STM32_L4

config BOARD
	default "stm32"

config ZMK_KEYBOARD_NAME
	default "STM32"

config ZMK_USB
	default y

endif
```

## app/boards/arm/stm32/stm32_f1_defconfig
```kconfig
# Copyright (c) 2022 The ZMK Contributors
# SPDX-License-Identifier: MIT

# SoC
CONFIG_SOC_SERIES_STM32F1X=y
CONFIG_SOC_STM32F103XB=y
CONFIG_CLOCK_CONTROL=y
CONFIG_PINCTRL=y

# Logging
CONFIG_LOG=y
CONFIG_SERIAL=y
CONFIG_CONSOLE=y
CONFIG_UART_CONSOLE=y

# Key scanning
CONFIG_GPIO_STM32_SWJ_NOJTAG=y
CONFIG_ZMK_HID_REPORT_TYPE_NKRO=y
CONFIG_ZMK_KSCAN_DIRECT_POLLING=y
```

## app/drivers/led_strip/Kconfig.ws2812
```kconfig
# Copyright (c) 2022 The ZMK Contributors
# SPDX-License-Identifier: MIT

config WS2812_STRIP_PWM
	bool "Enable the PWM driver"
	depends on SOC_FAMILY_STM32
	select PWM
	select USE_STM32_LL_TIM
	help
	  The PWM driver does hardware timer specific functions,
	  and is not available on all SoCs.
```

## app/dts/bindings/led_strip/worldsemi,ws2812-pwm.yaml
```yaml
# Copyright (c) 2019, Nordic Semiconductor ASA
# Copyright (c) 2022, Radiotechnical Systems LLC
# SPDX-License-Identifier: Apache-2.0

description: |
  Worldsemi WS2812 LED strip, PWM binding
  Driver bindings for controlling a WS2812 or compatible LED
  strip with a PWM.
  The PWM driver should be usable as long as a zephyr PWM API driver
  is available for your board.
  Use of this driver implies no internal memory overhead.
compatible: "worldsemi,ws2812-pwm"

include: [base.yaml, ws2812.yaml]

properties:
  label:
    required: true

  pwms:
    required: true
    type: phandle-array

  t0h-ns:
    type: int
    required: false
    default: 350
    description: logic-zero pulse duration in ns.

  t1h-ns:
    type: int
    required: false
    default: 700
    description: logic-one pulse duration in ns.

  period-ns:
    type: int
    required: false
    default: 1250
    description: period (TL+TH) in ns.
```
